## main_code/main/Kconfig.projbuild
```kconfig
menu "Example Configuration"

    config TX_GPIO_NUM
        int "TX GPIO number"
        default 2 if IDF_TARGET_ESP32C3
        default 20 if IDF_TARGET_ESP32S2
        default 13 if IDF_TARGET_ESP32
        default 5 if IDF_TARGET_ESP32S3
        help
            This option selects the GPIO pin used for the TX signal. Connect the
            TX signal to your transceiver.

    config RX_GPIO_NUM
        int "RX GPIO number"
        default 3 if IDF_TARGET_ESP32C3
        default 21 if IDF_TARGET_ESP32S2
        default 14 if IDF_TARGET_ESP32
        default 4 if IDF_TARGET_ESP32S3
        help
            This option selects the GPIO pin used for the RX signal. Connect the
            RX signal to your transceiver.

endmenu
```
